/dts-v1/;
/plugin/;
/ {
	fragment@0 {
		target = <&i2c1>;
		__overlay__ {
            #address-cells = <1>;
            #size-cells = <0>;

			bmp180: bmp180@77 {
				compatible = "MyI2CSensors,bmp180";
				reg = <0x77>;
                status = "okay";
			};
		};
	};
};
